## main/Kconfig.projbuild
```kconfig
menu "SlumberCube Configuration"

    menu "Night Mode Configuration"
        config NIGHT_START_HOUR
            int "Night mode start hour (0-23)"
            range 0 23
            default 23
        config NIGHT_START_MINUTE
            int "Night mode start minute (0-59)"
            range 0 59
            default 0
        config NIGHT_END_HOUR
            int "Night mode end hour (0-23)"
            range 0 23
            default 6
    endmenu

    menu "Sleep Configuration"
        config ACTIVE_DURATION_SECS
            int "Active duration before deep sleep (seconds)"
            default 1800
        config WAKEUP_GPIO
            int "Wakeup GPIO number"
            default 3
        config WAKEUP_HOUR
            int "Auto-wakeup hour (0-23)"
            range 0 23
            default 7
        config WAKEUP_MINUTE
            int "Auto-wakeup minute (0-59)"
            range 0 59
            default 50
    endmenu

    menu "GPIO Pin Configuration"
        config PIN_MOSI
            int "SPI MOSI pin"
            default 10
        config PIN_CLK
            int "SPI CLK pin"
            default 7
        config PIN_CS
            int "SPI CS pin (-1 = grounded)"
            default -1
        config PIN_DC
            int "SPI DC pin"
            default 8
        config PIN_RST
            int "SPI RST pin"
            default 20
        config PIN_NS4168_CTRL
            int "NS4168 amplifier control pin"
            default 2
        config PIN_I2S_SDIN
            int "I2S SDIN pin (NS4168 data)"
            default 4
        config PIN_I2S_SCLK
            int "I2S SCLK pin (NS4168 bit clock)"
            default 5
        config PIN_I2S_LROUT
            int "I2S LROUT pin (NS4168 word select)"
            default 6
        config RIGHT_BUTTON_GPIO
            int "右键 GPIO (wake/sleep/night-toggle)"
            default 3
        config LEFT_BUTTON_GPIO
            int "左键 GPIO (play/pause/skip)"
            default 1
    endmenu

    menu "Audio Configuration"
        config AUDIO_ENABLE
            bool "Enable audio playback on wakeup"
            default y
        config AUDIO_VOLUME_PCT
            int "Audio volume (0-100)"
            range 0 100
            default 10
    endmenu

    menu "WiFi Provisioning"
        config WIFI_PROV_AP_PASSWORD
            string "SoftAP password (min 8 chars for WPA2)"
            default "setup12345678"
            help
              Password for the SlumberCube-XXXX SoftAP. Must be at least 8
              characters to enable WPA2-PSK; otherwise the AP falls back to
              OPEN auth. Encoded into the QR code shown on the OLED.
        config WIFI_PROV_TIMEOUT_SECS
            int "Provisioning timeout (seconds)"
            range 60 1800
            default 300
            help
              How long to keep the AP + HTTP server alive without a successful
              submission before giving up and falling back to menuconfig creds.
        config WIFI_PROV_AUTO_ON_FIRST_BOOT
            bool "Auto-enter provisioning on first boot"
            default y
            help
              When enabled, the device starts the SoftAP + captive portal
              automatically on first boot (when no NVS credentials exist).
              When disabled, the user must triple-click the button to enter
              provisioning mode.
    endmenu

    menu "I2C Bus Configuration"
        config I2C_BUS_SDA_GPIO
            int "I2C SDA pin"
            default 21
        config I2C_BUS_SCL_GPIO
            int "I2C SCL pin"
            default 9
        config I2C_BUS_FREQ_HZ
            int "I2C bus frequency (Hz)"
            default 400000
    endmenu

    menu "PCF85063 RTC Configuration"
        config PCF85063_ENABLE
            bool "Enable PCF85063 RTC"
            default y
            help
                When enabled, the firmware initialises the PCF85063ATT/AJ
                RTC on the shared I2C bus at startup, reads the current
                time, and writes NTP-corrected time back after SNTP sync.
                Alarm wakeup is also available.
        config PCF85063_I2C_ADDR
            hex "PCF85063 I2C address"
            default 0x51
            range 0x50 0x51
            depends on PCF85063_ENABLE
        config PCF85063_INT_GPIO
            int "PCF85063 INT pin"
            default 0
            depends on PCF85063_ENABLE
    endmenu

    menu "Debug Configuration"
        config I2C_SCAN_AT_BOOT
            bool "I2C bus scan at boot (debug, default off)"
            default n
            help
              Probes all 7-bit I²C addresses 0x00..0x7F at startup and logs
              which ones ACK. Use to confirm whether PCF85063 / SHTC3 are
              physically present on the shared I²C bus. Disable (default) in
              production.
    endmenu

    menu "SHTC3 Sensor Configuration"
        config SHTC3_TEMP_OFFSET_TENTHS_C
            int "SHTC3 temperature offset in tenths of °C subtracted from raw reading"
            default 0
            range -100 100
            help
              Compensate for systematic bias from PCB self-heating. Causes:
              SHTC3 idle current ~200 µA, nearby LDO/charger IC, ESP32-C3 die,
              OLED display. Typical bedside-clock bias is +1 to +3 °C
              (set value 10..30 to subtract that much). Tune against a
              reference thermometer after the device has been running >=5 min.
    endmenu

endmenu
```
