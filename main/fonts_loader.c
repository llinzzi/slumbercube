/* fonts_loader.c — Runtime font loader from dedicated flash partition.
 *
 * At boot, mmaps the "fonts" partition (type 0x40, subtype 0x00) and
 * reconstructs lv_font_t objects pointing into mmap'd flash.  This keeps
 * the 300KB+ of bitmap and glyph-descriptor data in flash, with only
 * ~2 KB of struct overhead in DRAM.
 *
 * The partition is populated once over USB with:
 *   parttool.py write_partition --partition-name=fonts --input=fonts.bin
 *
 * fonts.bin is generated by tools/extract_fonts.py from the original
 * font_digital.c / font_station.c sources.
 */

#include "fonts_loader.h"
#include "esp_log.h"
#include "esp_partition.h"
#include "esp_err.h"
#include <string.h>

static const char *TAG = "FONTS_LOADER";

/* ── Blob format constants (must match extract_fonts.py) ─────────── */
#define BLOB_MAGIC       0x544E4684  /* "FNT\x01" le */
#define BLOB_VERSION     1
#define FONT_ENTRY_SIZE  60
#define CMAP_ENTRY_SIZE  24
#define HEADER_SIZE      16
#define NON_NULL_SENT    0xFFFFFFFF  /* marks a NULL pointer in the blob */

/* Globals exported to the rest of the firmware — struct values, not pointers,
 * matching the original font_digital.c / font_station.c declarations. */
lv_font_t lv_font_digital;
const lv_font_t lv_font_station;

/* mmap handle — kept alive for the lifetime of the app */
static esp_partition_mmap_handle_t s_mmap_handle = 0;
static const void *s_mmap_ptr = NULL;

/* ── Font lookup by name hash ────────────────────────────────────── */

static uint32_t djb2_hash(const char *s) {
    uint32_t h = 5381;
    while (*s) h = ((h * 33) + (unsigned char)*s++) & 0xFFFFFFFF;
    return h;
}

/* ── Initialisation ──────────────────────────────────────────────── */

esp_err_t fonts_loader_init(void)
{
    /* Already loaded? */
    if (s_mmap_ptr) return ESP_OK;

    /* ── Find the fonts partition ── */
    const esp_partition_t *part =
        esp_partition_find_first((esp_partition_type_t)0x40,
                                 (esp_partition_subtype_t)0x00, NULL);
    if (!part) {
        ESP_LOGE(TAG, "Fonts partition (type=0x40, subtype=0x00) not found");
        return ESP_ERR_NOT_FOUND;
    }
    ESP_LOGI(TAG, "Fonts partition: offset=0x%lx size=%lu KB",
             (unsigned long)part->address, (unsigned long)part->size / 1024);

    /* ── Memory-map the partition ── */
    esp_err_t err = esp_partition_mmap(part, 0, part->size,
                                       ESP_PARTITION_MMAP_DATA,
                                       &s_mmap_ptr, &s_mmap_handle);
    if (err != ESP_OK) {
        ESP_LOGE(TAG, "mmap failed: %s", esp_err_to_name(err));
        return err;
    }

    /* ── Validate header ── */
    const uint8_t *blob = (const uint8_t *)s_mmap_ptr;
    uint32_t magic, version, font_count;
    memcpy(&magic,   blob,      4);
    memcpy(&version, blob + 4,  4);
    memcpy(&font_count, blob + 8, 4);

    if (magic != BLOB_MAGIC) {
        ESP_LOGE(TAG, "Bad magic: 0x%08" PRIX32 " (expected 0x%08X)", magic, BLOB_MAGIC);
        return ESP_ERR_INVALID_RESPONSE;
    }
    if (version != BLOB_VERSION) {
        ESP_LOGE(TAG, "Unsupported blob version %" PRIu32, version);
        return ESP_ERR_INVALID_VERSION;
    }

    ESP_LOGI(TAG, "Blob: version=%" PRIu32 " fonts=%" PRIu32, version, font_count);

    /* ── Process each font entry ── */
    for (uint32_t fi = 0; fi < font_count; fi++) {
        const uint8_t *entry = blob + HEADER_SIZE + fi * FONT_ENTRY_SIZE;

        /* Decode entry fields (see extract_fonts.py make_font_entry) */
        uint32_t name_hash, data_offset, data_size;
        uint32_t bitmap_offset, bitmap_size;
        uint32_t dsc_offset, dsc_count, dsc_entry_size;
        uint32_t cmap_offset, cmap_count, cmap_entry_size;
        uint16_t bpp, bitmap_format, subpx;
        int16_t  line_height, base_line, underline_pos, underline_thick;

        memcpy(&name_hash,        entry + 0,  4);
        memcpy(&data_offset,      entry + 4,  4);
        memcpy(&data_size,        entry + 8,  4);
        memcpy(&bitmap_offset,    entry + 12, 4);
        memcpy(&bitmap_size,      entry + 16, 4);
        memcpy(&dsc_offset,       entry + 20, 4);
        memcpy(&dsc_count,        entry + 24, 4);
        memcpy(&dsc_entry_size,   entry + 28, 4);
        memcpy(&cmap_offset,      entry + 32, 4);
        memcpy(&cmap_count,       entry + 36, 4);
        memcpy(&cmap_entry_size,  entry + 40, 4);
        memcpy(&bpp,              entry + 44, 2);
        memcpy(&bitmap_format,    entry + 46, 2);
        memcpy(&subpx,            entry + 48, 2);
        memcpy(&line_height,      entry + 50, 2);
        memcpy(&base_line,        entry + 52, 2);
        memcpy(&underline_pos,    entry + 54, 2);
        memcpy(&underline_thick,  entry + 56, 2);

        /* Absolute pointer to this font's data block */
        const uint8_t *font_data = blob + data_offset;

        ESP_LOGI(TAG, "Font %" PRIu32 ": hash=0x%08" PRIX32 " data=+0x%" PRIX32
                 "(%" PRIu32 "B) glyphs=%" PRIu32 " bpp=%u",
                 fi, name_hash, data_offset, data_size, dsc_count, bpp);

        /* ── Allocate lv_font_fmt_txt_dsc_t in DRAM ── */
        lv_font_fmt_txt_dsc_t *dsc = lv_malloc(sizeof(*dsc));
        if (!dsc) {
            ESP_LOGE(TAG, "OOM for font_dsc");
            return ESP_ERR_NO_MEM;
        }
        memset(dsc, 0, sizeof(*dsc));
        dsc->glyph_bitmap  = font_data + bitmap_offset;
        dsc->glyph_dsc     = (const lv_font_fmt_txt_glyph_dsc_t *)(font_data + dsc_offset);
        dsc->kern_dsc      = NULL;
        dsc->kern_scale    = 0;
        dsc->cmap_num      = cmap_count;
        dsc->bpp           = (uint8_t)bpp;
        dsc->kern_classes  = 0;
        dsc->bitmap_format = (lv_font_fmt_txt_bitmap_format_t)bitmap_format;

        /* ── Rebuild cmaps in DRAM (fix up pointer fields) ── */
        if (cmap_count > 0) {
            dsc->cmaps = lv_malloc(cmap_count * sizeof(lv_font_fmt_txt_cmap_t));
            if (!dsc->cmaps) {
                lv_free(dsc);
                ESP_LOGE(TAG, "OOM for cmaps (%" PRIu32 " entries)", cmap_count);
                return ESP_ERR_NO_MEM;
            }

            const uint8_t *blob_cmaps = font_data + cmap_offset;
            lv_font_fmt_txt_cmap_t *ram_cmaps = (lv_font_fmt_txt_cmap_t *)dsc->cmaps;

            for (uint32_t ci = 0; ci < cmap_count; ci++) {
                const uint8_t *bcm = blob_cmaps + ci * cmap_entry_size;
                uint32_t range_start, range_length, glyph_id_start;
                uint32_t unicode_off, glyph_off;
                uint16_t list_length, cmap_type;

                memcpy(&range_start,     bcm + 0,  4);
                memcpy(&range_length,    bcm + 4,  4);
                memcpy(&glyph_id_start,  bcm + 8,  4);
                memcpy(&unicode_off,     bcm + 12, 4);
                memcpy(&glyph_off,       bcm + 16, 4);
                memcpy(&list_length,     bcm + 20, 2);
                memcpy(&cmap_type,       bcm + 22, 2);

                ram_cmaps[ci].range_start     = range_start;
                ram_cmaps[ci].range_length    = range_length;
                ram_cmaps[ci].glyph_id_start  = glyph_id_start;
                /* unicode_off / glyph_off in the blob are relative to
                 * the font data block start.  The data block is at
                 * blob + data_offset. */
                ram_cmaps[ci].unicode_list    = (unicode_off != NON_NULL_SENT)
                    ? (const uint16_t *)(blob + data_offset + unicode_off)
                    : NULL;
                ram_cmaps[ci].glyph_id_ofs_list = (glyph_off != NON_NULL_SENT)
                    ? (const void *)(blob + data_offset + glyph_off)
                    : NULL;
                ram_cmaps[ci].list_length      = list_length;
                ram_cmaps[ci].type             = (lv_font_fmt_txt_cmap_type_t)cmap_type;
            }
        } else {
            dsc->cmaps = NULL;
        }

        /* ── Allocate lv_font_t in DRAM ── */
        lv_font_t *font = lv_malloc(sizeof(*font));
        if (!font) {
            ESP_LOGE(TAG, "OOM for lv_font_t");
            return ESP_ERR_NO_MEM;
        }
        memset(font, 0, sizeof(*font));
        font->get_glyph_dsc    = lv_font_get_glyph_dsc_fmt_txt;
        font->get_glyph_bitmap = lv_font_get_bitmap_fmt_txt;
        font->line_height      = (uint16_t)line_height;
        font->base_line        = (int8_t)base_line;
        font->subpx            = (uint8_t)subpx;
        font->underline_position  = (int8_t)underline_pos;
        font->underline_thickness = (int8_t)underline_thick;
        font->dsc              = dsc;
        font->fallback         = NULL;
        font->user_data        = NULL;

        /* ── Copy to the correct global struct ── */
        if (name_hash == djb2_hash("lv_font_digital")) {
            memcpy(&lv_font_digital, font, sizeof(lv_font_t));
            ESP_LOGI(TAG, "  -> lv_font_digital");
        } else if (name_hash == djb2_hash("lv_font_station")) {
            memcpy((void *)&lv_font_station, font, sizeof(lv_font_t));
            ESP_LOGI(TAG, "  -> lv_font_station");
        } else {
            ESP_LOGW(TAG, "  -> unknown font (hash=0x%08" PRIX32 "), skipping", name_hash);
        }
        lv_free(font);
    }

    return ESP_OK;
}
